## wic/pine64-image.wks
```
# short-description: Create Pine64 SD card image
# long-description: Creates a partitioned SD card image. Boot files
# are located in the first vfat partition and raw bootloaders are
# placed in the raw SD.
#
# The disk layout used is:
#
#    0                    -> reserverd
#    8 KiB                -> u-boot SPL and u-boot
#    20480 KiB            -> kernel, dtbs, boot script
#    20480 KiB + 100 MiB  -> rootfs
#

part spl --source rawcopy --sourceparams="file=u-boot-sunxi-with-spl.bin" --ondisk mmcblk --no-table --align 8
part /boot --source bootimg-partition --ondisk mmcblk0 --fstype=vfat --label pine64 --active --size=100M --align 20480
part / --source rootfs --ondisk mmcblk0 --fstype=ext4 --label platform --align 4096
```
